## build/app/Kconfig/boards/Kconfig.nrf52840dk
```kconfig
# Load board Kconfig descriptions.
osource "C:/ncs/v3.0.0/zephyr/boards/nordic/nrf52840dk/Kconfig.nrf52840dk"
```

## build/app/Kconfig/boards/Kconfig.sysbuild
```kconfig
# Load Sysbuild board Kconfig descriptions.
osource "C:/ncs/v3.0.0/zephyr/boards/nordic/nrf52840dk/Kconfig.sysbuild"
```

## build/poller/Kconfig/boards/Kconfig.defconfig
```kconfig
# Load Zephyr board defconfig descriptions.
osource "C:/ncs/v3.0.0/zephyr/boards/nordic/nrf52840dk/Kconfig.defconfig"
```
